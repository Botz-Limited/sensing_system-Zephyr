## src/idle/Kconfig
```kconfig
# Idle Module Configuration

config IDLE_MODULE
    bool "Enable Idle module"
    default y
    help
      Enable the idle module for power management activities

if IDLE_MODULE

module = IDLE_MODULE
module-str = idle module
source "subsys/logging/Kconfig.template.log_config"

config IDLE_MODULE_LOG_LEVEL
	int "Idle module log level"
	depends on IDLE_MODULE && LOG
	default 2
	help
	  Sets log level for idle module

config IDLE_MODULE_STACK_SIZE
    int "Stack size for idle thread"
    default 2048
    help
      Stack size for the idle thread.

config IDLE_MODULE_PRIORITY
    int "Priority of the idle thread"
    default 7
    range 1 10
    help
      Thread priority for idle module.
      Lower number means higher priority.

config IDLE_INACTIVITY_TIMEOUT_MINUTES
    int "Minutes of inactivity before sleep"
    default 1
    range 1 60
    help
      Number of minutes without motion sensor activity
      before entering sleep mode.

config IDLE_ENABLE_POWER_MANAGEMENT
    bool "Enable power management in idle module"
    default n
    help
      Enable system power management based on motion sensor activity.
      When enabled, the system will enter sleep mode after the configured
      inactivity timeout and wake on BHI360 interrupts.

config IDLE_PERIODIC_CHECK_SECONDS
    int "Periodic check interval in seconds"
    default 10
    range 1 60
    help
      How often to check for inactivity in seconds.

config IDLE_MOTION_THRESHOLD_QUATERNION
    int "Motion detection quaternion threshold (x1000)"
    default 90
    range 10 200
    help
      Threshold for detecting motion via quaternion changes.
      Value is multiplied by 1000 (e.g., 50 = 0.05 actual threshold).
      Larger values reduce sensitivity to sensor drift.
      Recommended: 50-100 to avoid false triggers from drift.

endif # IDLE_MODULE
```

## src/motion_sensor/Kconfig
```kconfig
config MOTION_SENSOR_MODULE
	bool "Motion Sensor Module"
	select GPIO
	select SPI
	select SPIM
	help
	  MOTION_SENSOR MODULE

if MOTION_SENSOR_MODULE

module = MOTION_SENSOR_MODULE
module-str = MOTION_SENSOR module
source "subsys/logging/Kconfig.template.log_config"

config MOTION_SENSOR_MODULE_LOG_LEVEL
	int "Motion Sensor module log level"
	depends on MOTION_SENSOR_MODULE && LOG
	default 2
	help
	  Sets log level for Motion Sensor module


config MOTION_SENSOR_MODULE_STACK_SIZE
	int "Motion Sensor module thread stack size"
	default 4096

config MOTION_SENSOR_MODULE_PRIORITY
	int "Motion Sensor module thread priority"
	default 4

endif # MOTION_SENSOR_MODULE
```

## src/packetizer/Kconfig
```kconfig
config PACKETIZER_MODULE
	bool "Packetizer Module"
	help
	  PACKETIZER MODULE

if PACKETIZER_MODULE

module = PACKETIZER_MODULE
module-str = packetizer module
source "subsys/logging/Kconfig.template.log_config"

endif # PACKETIZER_MODULE
```

## src/realtime_metrics/Kconfig
```kconfig
#
# Copyright (c) 2025 Botz Innovation
#

menu "Realtime Metrics Module"

config REALTIME_METRICS_MODULE
	bool "Enable realtime metrics calculation module"
	default y
	help
	  Enable the realtime metrics module for BLE updates

config REALTIME_METRICS_MODULE_LOG_LEVEL
	int "Realtime metrics module log level"
	depends on REALTIME_METRICS_MODULE && LOG
	default 2
	help
	  Sets log level for realtime metrics module

config REALTIME_METRICS_MODULE_STACK_SIZE
	int "Realtime metrics module thread stack size"
	default 6144
	depends on REALTIME_METRICS_MODULE
	help
	  Stack size for realtime metrics processing thread

config REALTIME_METRICS_MODULE_PRIORITY
	int "Realtime metrics module thread priority"
	default 6
	depends on REALTIME_METRICS_MODULE
	help
	  Priority for realtime metrics processing thread (lower number = higher priority)

endmenu
```

## src/sensor_data/Kconfig
```kconfig
#
# Copyright (c) 2025 Botz Innovation
#

menu "Sensor Data Module"

config SENSOR_DATA_MODULE
	bool "Enable sensor data consolidation module"
	default y
	help
	  Enable the sensor data module for high-frequency sensor consolidation

config SENSOR_DATA_MODULE_LOG_LEVEL
	int "Sensor data module log level"
	depends on SENSOR_DATA_MODULE && LOG
	default 2
	help
	  Sets log level for sensor data module

config SENSOR_DATA_MODULE_STACK_SIZE
	int "Sensor data module thread stack size"
	default 4096
	depends on SENSOR_DATA_MODULE
	help
	  Stack size for sensor data processing thread

config SENSOR_DATA_MODULE_PRIORITY
	int "Sensor data module thread priority"
	default 4
	depends on SENSOR_DATA_MODULE
	help
	  Priority for sensor data processing thread (lower number = higher priority)

config SENSOR_DATA_MSGQ_SIZE
    int "Sensor data message queue size"
    default 64
    range 16 128
    help
      Size of the sensor data message queue. Increase this if you see
      "Failed to send foot sensor data to sensor data module" warnings.
      Primary devices need larger queues to handle data from both feet.

endmenu
```

## src/shell_commands/Kconfig
```kconfig
config LOG_DECODER_SHELL_CMD
    bool "Enable log decoder shell commands"
    default y
    depends on SHELL
    depends on FILE_SYSTEM
    help
      Enable shell commands for log file management and decoding.
      Commands include:
        - log list: List all log files
        - log decode foot: Decode latest foot sensor log
        - log decode bhi360: Decode latest BHI360 log
        - log decode file <path>: Decode specific file
        - log delete_all: Delete all log files
```

## src/tools/Kconfig
```kconfig
menuconfig LOG_DECODER_TOOL
    bool "Enable log decoder tool"
    default n
    depends on FILE_SYSTEM
    help
      Enable the log decoder tool that can decode and display
      foot sensor and BHI360 log files. This adds shell commands
      to list and decode log files.

if LOG_DECODER_TOOL

config LOG_DECODER_SHELL_CMDS
    bool "Enable shell commands for log decoder"
    default y
    depends on SHELL
    help
      Enable shell commands for the log decoder tool.
      Commands include: log list, log foot, log bhi360, log decode <path>

endif # LOG_DECODER_TOOL
```

## src/wifi/Kconfig
```kconfig
config WIFI_MODULE
	bool "Wifi Module"
	help
	  WIFI MODULE

if WIFI_MODULE

module = WIFI_MODULE
module-str = wifi module
source "subsys/logging/Kconfig.template.log_config"

config WIFI_MODULE_STACK_SIZE
	int "Wifi module thread stack size"
	default 4096

config WIFI_MODULE_PRIORITY
	int "Wifi module thread priority"
	default 6

endif # WIFI_MODULE
```

## sysbuild/mcuboot/boards/nrf5340dk_nrf5340_cpuapp.conf
```kconfig
# MCUboot board-specific configuration for nRF5340DK
# This file is automatically included when building for nrf5340dk_nrf5340_cpuapp

# Multi-image updates require upgrade-only mode
CONFIG_BOOT_UPGRADE_ONLY=y

# External flash configuration
CONFIG_NORDIC_QSPI_NOR=y
CONFIG_NORDIC_QSPI_NOR_FLASH_LAYOUT_PAGE_SIZE=4096
CONFIG_NORDIC_QSPI_NOR_STACK_WRITE_BUFFER_SIZE=256

# The network core cannot access external flash directly. The flash simulator must be used to
# allow MCUboot to transfer the network core update image from the external flash to the network
# core flash memory.
CONFIG_FLASH_SIMULATOR=y
CONFIG_FLASH_SIMULATOR_DOUBLE_WRITES=y
CONFIG_FLASH_SIMULATOR_STATS=n

# Enable MCUboot logging for debugging
CONFIG_LOG=y
CONFIG_MCUBOOT_LOG_LEVEL_INF=y

# Increase stack size for SHA256 operations
CONFIG_MAIN_STACK_SIZE=10240

# Enable hardware accelerated crypto if available
CONFIG_HW_CC3XX=y

# Additional fixes for QSPI flash access after FOTA
# Ensure proper alignment for flash reads
CONFIG_FLASH_LOAD_OFFSET=0x10000
CONFIG_FLASH_LOAD_SIZE=0x40000

# Enable proper synchronization
CONFIG_MULTITHREADING=y

# Ensure QSPI is ready before accessing
CONFIG_NORDIC_QSPI_NOR_INIT_PRIORITY=40

# Ensure flash simulator uses proper alignment
CONFIG_FLASH_SIMULATOR_UNALIGNED_READ=n

# Enable debugging to help diagnose issues
CONFIG_DEBUG=y
CONFIG_BOOT_BANNER=y

# Ensure sufficient heap for mbedTLS operations
CONFIG_MBEDTLS_HEAP_SIZE=8192

# Disable PSA crypto to use traditional mbedTLS
CONFIG_MBEDTLS_USE_PSA_CRYPTO=n

# Use smaller SHA256 implementation
CONFIG_MBEDTLS_SHA256_SMALLER=y

# Ensure proper initialization order
CONFIG_FLASH_INIT_PRIORITY=40
```

## tests/analytics/testcase.yaml
```yaml
tests:
  analytics.unit:
    platform_allow: native_posix native_posix_64
    tags: analytics unit
    harness: ztest
    min_ram: 32
    min_flash: 64
```

## tests/app_events/testcase.yaml
```yaml
tests:
  app_events.unit:
    platform_allow: native_posix
    tags: app_events unit events
```
