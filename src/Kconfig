## src/Kconfig
```kconfig
rsource "app/Kconfig"
rsource "data/Kconfig"
rsource "bluetooth/Kconfig"
rsource "app_events/Kconfig"
rsource "foot_sensor/Kconfig"
rsource "motion_sensor/Kconfig"
rsource "packetizer/Kconfig"
rsource "battery/Kconfig"
rsource "wifi/Kconfig"
rsource "Kconfig.fota"


# Sensor Criticality Configuration
choice PRIMARY_SENSING_FUNCTION
    prompt "Primary sensing function"
    default PRIMARY_FUNCTION_BOTH
    help
      Select which sensor is critical for system operation.
      Non-critical sensors will report errors but not prevent system startup.

    config PRIMARY_FUNCTION_FOOT
        bool "Foot pressure sensing is primary"
        help
          Foot sensor failures will prevent system startup.
          Motion sensor failures will be reported but system continues.
        
    config PRIMARY_FUNCTION_MOTION
        bool "Motion/IMU sensing is primary"
        help
          Motion sensor failures will prevent system startup.
          Foot sensor failures will be reported but system continues.
        
    config PRIMARY_FUNCTION_BOTH
        bool "Both sensors are required"
        help
          Either sensor failure will prevent system startup.
endchoice

# Derived configs for easier use in code
config FOOT_SENSOR_OPTIONAL
    bool
    default y if PRIMARY_FUNCTION_MOTION
    default n

config MOTION_SENSOR_OPTIONAL
    bool
    default y if PRIMARY_FUNCTION_FOOT
    default n
```

## src/Kconfig.fota
```kconfig
menu "FOTA Configuration"

config FOTA_PRIMARY_SIZE_ESTIMATE
    int "Estimated primary firmware size in bytes"
    default 780000
    help
      Estimated size of primary firmware app core for progress calculation.
      Network core is updated separately with its own progress.
      Update this based on your typical app core build size.

config FOTA_SECONDARY_SIZE_ESTIMATE
    int "Estimated secondary firmware size in bytes"
    default 780000
    help
      Estimated size of secondary firmware app core for progress calculation.
      Network core is updated separately with its own progress.
      Secondary typically has similar size to primary.

config FOTA_NETCORE_SIZE_ESTIMATE
    int "Estimated network core firmware size in bytes"
    default 159000
    help
      Estimated size of network core firmware for progress calculation.
      This is typically much smaller than the application core.
      Default is 159KB for nRF5340 network core (actual ~158.5KB).

config FOTA_DYNAMIC_SIZE_DETECTION
    bool "Enable dynamic FOTA size detection"
    default y
    help
      When enabled, the system will remember the size of the last
      successful FOTA update and use it for future progress calculations.
      Falls back to configured estimates if no previous size is known.

endmenu
```

## src/activity_metrics/Kconfig
```kconfig
# Activity Metrics Module Configuration

config ACTIVITY_METRICS_MODULE
    bool "Enable activity metrics processing module"
    default y
    help
      Enable the activity metrics module that processes sensor data
      to calculate running metrics like cadence, contact time, form score, etc.

if ACTIVITY_METRICS_MODULE

module = ACTIVITY_METRICS_MODULE
module-str = activity metrics module
source "subsys/logging/Kconfig.template.log_config"

config ACTIVITY_METRICS_MODULE_LOG_LEVEL
	int "Activity metrics module log level"
	depends on ACTIVITY_METRICS_MODULE && LOG
	default 2
	help
	  Sets log level for activity metrics module

config ACTIVITY_METRICS_MODULE_STACK_SIZE
    int "Stack size for activity metrics thread"
    default 6144
    help
      Stack size for the activity metrics processing thread.
      Increase if stack overflow occurs.

config ACTIVITY_METRICS_MODULE_PRIORITY
    int "Priority of activity metrics thread"
    default 6
    range 1 10
    help
      Thread priority for activity metrics processing.
      Lower number means higher priority.

endif # ACTIVITY_METRICS_MODULE
```

## src/analytics/Kconfig
```kconfig
#
# Copyright (c) 2025 Botz Innovation
#

menu "Analytics Module"

config ANALYTICS_MODULE
	bool "Enable analytics module"
	default y
	help
	  Enable the analytics module for complex metric calculations.

config ANALYTICS_MODULE_LOG_LEVEL
	int "Analytics module log level"
	default 3
	range 0 4
	help
	  Log level for analytics module
	  0 - OFF
	  1 - ERROR
	  2 - WARNING
	  3 - INFO
	  4 - DEBUG

config ANALYTICS_MODULE_STACK_SIZE
	int "Analytics thread stack size"
	default 4096
	help
	  Stack size for the analytics processing thread

config ANALYTICS_MODULE_PRIORITY
	int "Analytics thread priority"
	default 5
	help
	  Priority of the analytics processing thread

endmenu
```

## src/app/Kconfig
```kconfig
config APP_MODULE
	bool "App Module"
	default y
	select GPIO
	help
	  APP MODULE

if APP_MODULE

module = APP_MODULE
module-str = app module
source "subsys/logging/Kconfig.template.log_config"

config APP_MODULE_LOG_LEVEL
	int "App module log level"
	depends on APP_MODULE && LOG
	default 2
	help
	  Sets log level for App module

config APP_PAUSED_TIMEOUT_MINS
	int "Duration the system will stay paused before power off"
	default 5

config APP_MODULE_STACK_SIZE
	int "App module thread stack size"
	default 3072

config APP_MODULE_PRIORITY
	int "App module thread priority"
	default 9

endif # APP_MODULE
```

## src/app_events/Kconfig
```kconfig
config APPLICATION_EVENTS
	bool "Application Events"
	select APP_EVENT_MANAGER
	help
	  SYSTEM EVENTS

if APPLICATION_EVENTS

module = APPLICATION_EVENTS
module-str = application events
source "subsys/logging/Kconfig.template.log_config"

endif # APPLICATION_EVENTS
```

## src/battery/Kconfig
```kconfig
config BATTERY_MODULE
	bool "Battery Module"
	select GPIO
	select I2C_NRFX_TWIM
	help
	  BATTERY MODULE

if BATTERY_MODULE

module = BATTERY_MODULE
module-str = BATTERY module
source "subsys/logging/Kconfig.template.log_config"

config BATTERY_MODULE_LOG_LEVEL
	int "Battery module log level"
	depends on BATTERY_MODULE && LOG
	default 2
	help
	  Sets log level for Battery module


config BATTERY_MODULE_STACK_SIZE
	int "Battery module thread stack size"
	default 3072

config BATTERY_PRIORITY
	int "Battery module thread priority"
	default 8

endif # BATTERY_MODULE
```

## src/bluetooth/Kconfig
```kconfig
DT_CHOSEN_EXT_FLASH:= nordic,pm-ext-flash

config BLUETOOTH_MODULE
	bool "Bluetooth Module"
	# Bluetooth Stack
	select BT
	select BT_SMP
	select BT_PERIPHERAL
	select CBPRINTF_FP_SUPPORT
	# Bluetooth Battery Service
	select BT_BAS
	# Paring
	select BT_PRIVACY
	select BT_KEYS_OVERWRITE_OLDEST
	# Settings
	select SETTINGS
	select SETTINGS_RUNTIME
	select SHELL
	select BT_SETTINGS
	select MCUMGR_SMP_BT
	select MCUMGR_SMP_BT_CONN_PARAM_CONTROL
	select MCUMGR_SMP_REASSEMBLY_BT

	# MCUMGR + SMP
	select MCUMGR
	select NET_BUF
	select ZCBOR
	select CRC
	select MCUMGR_TRANSPORT_BT
	select MCUMGR_TRANSPORT_BT_CONN_PARAM_CONTROL
	select IMG_MANAGER
	select STREAM_FLASH
	select FLASH_MAP
	select FLASH
	select MCUMGR_GRP_OS
	select MCUMGR_GRP_OS_BOOTLOADER_INFO
	select MCUMGR_TRANSPORT_BT_REASSEMBLY
	select MCUMGR_GRP_FS
	select MCUMGR_CMD_FS_MGMT
	select MCUMGR_SMP_SHELL
	select MCUMGR_GRP_ZEPHYR_BASIC
	select MCUMGR_GRP_BASIC_CMD_STORAGE_ERASE
	select MCUMGR_CMD_IMG_MGMT
	select MCUMGR_CMD_OS_MGMT
	select MCUMGR_CMD_STAT_MGMT
	select MCUMGR_SMP_CLIENT

	#config BOOTLOADER_MCUBOOT
	#bool "mcuboot support"
	select MCUMGR_GRP_IMG
	# CONFIG_MCUMGR_GRP_IMG dependencies
	select FLASH
	select IMG_MANAGER
	select FLASH_MAP
	# CONFIG_IMG_MANAGER dependencies
	select STREAM_FLASH
	# DFU
	select NORDIC_SPI_NOR
	select NCS_SAMPLE_MCUMGR_BT_OTA_DFU_SPEEDUP
	help
		Bluetooth Module


config MCUMGR_TRANSPORT_BT_AUTHEN
	bool "Transport Auth"
	default n

config IMG_ERASE_PROGRESSIVELY
	bool
	default y

config MCUMGR_TRANSPORT_NETBUF_SIZE
	int
	default 2475

config MCUMGR_GRP_OS_MCUMGR_PARAMS
	bool
	default y


	help
	  BLUETOOTH_MODULE


if BLUETOOTH_MODULE

# Setting Configs
config BT_DEVICE_APPEARANCE
	int
	default 768

config BT_ATT_ENFORCE_FLOW
	bool "flow enforcement"
	default n

config BT_MAX_PAIRED
	int
	default 6


module = BLUETOOTH_MODULE
module-str = bluetooth module
source "subsys/logging/Kconfig.template.log_config"

config BLUETOOTH_MODULE_ADV_TIMEOUT_SECS
	int "Duration the system with advertise for"
	default 60

config BLUETOOTH_MODULE_STACK_SIZE
	int "BTH  module thread stack size"
	default 3072

config BLUETOOTH_MODULE_PRIORITY
	int "BTH module thread priority"
	default 3

config FOTA_PROXY_TIMEOUT_SEC
	int "FOTA proxy operation timeout in seconds"
	default 300
	help
	  Timeout for FOTA proxy operations. If a FOTA operation
	  doesn't complete within this time, it will be aborted.

config FOTA_SYNC_TIMEOUT_SEC
	int "FOTA synchronization timeout in seconds"
	default 30
	help
	  Timeout for waiting for secondary device to complete FOTA
	  when updating both devices. After this timeout, primary
	  will reset anyway.

config FILE_PROXY_TIMEOUT_SEC
	int "File proxy operation timeout in seconds"
	default 60
	help
	  Timeout for file proxy operations like file transfer.

config D2D_DISCOVERY_RETRY_COUNT
	int "D2D service discovery retry count"
	default 3
	help
	  Number of times to retry D2D service discovery if it fails.

config D2D_DISCOVERY_RETRY_DELAY_MS
	int "D2D service discovery retry delay in milliseconds"
	default 1000
	help
	  Delay between D2D service discovery retry attempts.

config LEGACY_BLE_ENABLED
	bool "Enable legacy BLE services for old app compatibility"
	default n
	help
	  Temporarily enable legacy BLE services to mimic old firmware for mobile app compatibility.
	  This is isolated and won't affect current BLE functionality.

config D2D_PARAMETERS_ONLY_MODE
	bool "Enable D2D Parameters-Only Mode for 99% battery savings"
	default y
	help
	  When enabled, bilateral calculations use 1Hz parameter packets instead of 100Hz raw data
	  for 99% battery savings. Parameters include GCT, stance time, swing time, peak pressure,
	  COP coordinates, and pronation. Legacy BLE continues to work with raw data for phone
	  compatibility. Seamless fallback to raw data when parameters unavailable.

endif # BLUETOOTH_MODULE
```

## src/bluetooth/Kconfig.3d_orientation
```kconfig
# 3D Orientation Service Configuration

config HIGH_RATE_3D_ORIENTATION
    bool "Enable high-rate 3D orientation updates"
    default n
    help
      Enable higher sampling and transmission rates for 3D orientation visualization.
      When enabled:
      - BHI360 quaternion sampling: 100Hz (instead of 50Hz)
      - BLE transmission rate: 50Hz (instead of 20Hz)
      - D2D transmission rate: 50Hz (instead of 20Hz)
      
      This provides smoother 3D visualization but increases power consumption
      and BLE bandwidth usage.

config 3D_ORIENTATION_BHI360_RATE
    int "BHI360 quaternion sampling rate (Hz)"
    default 100 if HIGH_RATE_3D_ORIENTATION
    default 50
    range 10 400
    help
      The rate at which the BHI360 outputs quaternion data.
      Higher rates provide smoother motion but increase power consumption.
      The BHI360 can support up to 400Hz for virtual sensors.

config 3D_ORIENTATION_BLE_RATE
    int "BLE transmission rate (Hz)"
    default 50 if HIGH_RATE_3D_ORIENTATION
    default 20
    range 1 50
    help
      The rate at which quaternion data is sent over BLE.
      Limited by BLE connection interval and bandwidth.
      Higher rates provide smoother visualization but may cause packet loss.
```

## src/data/Kconfig
```kconfig
config DATA_MODULE
	bool "Data Storage System"
	select NORDIC_QSPI_NOR
	select FLASH
	select FILE_SYSTEM
	select FLASH_MAP
	select FLASH_PAGE_LAYOUT
	select HWINFO
	select FILE_SYSTEM_LITTLEFS
	select FS_LITTLEFS_FMP_DEV
	select CONFIG_PM_PARTITION_REGION_LITTLEFS_EXTERNAL
	select FILE_SYSTEM_SHELL 
	select SETTINGS

# kconfigs required for shell test commands
	#select FLASH_JESD216_API
	select CONFIG_ENTROPY_DEVICE_RANDOM_GENERATOR

	help
	  DATA_MODULE

if DATA_MODULE

config NORDIC_QSPI_NOR_FLASH_LAYOUT_PAGE_SIZE
	int
	default 4096

config FILE_SYSTEM_MOUNT
	string
	default "/lfs1"

config SETTINGS_FS_DIR
	string
	default "/lfs1/"

config SETTINGS_FILE_PATH 
	string
	default "/lfs1/settings"

config LOG_BACKEND_FS_DIR
	string
	default "/lfs1/"

config DATA_MODULE_RESET_SETTINGS_FILE_ON_BOOT
	bool "Will wipe the settings file used by the setting subsytem on boot"
	default n

config DATA_MODULE_STACK_SIZE
	int "Data module thread stack size"
	default 8192

config DATA_MODULE_PRIORITY
	int "Data module thread priority"
	default 8

config BT_LONG_WQ_STACK_SIZE
	int
	default 4096	

config DATA_LOG_SPACE_LEFT_THRESHOLD_KB
	int  "Flash memory minimum free space in Kbytes to trigger file deletion"
	default 200

config DATA_DELETE_DAYS
	int "Number of logg days to delete if not enough space on the external flash"	
	default 7

config APP_WIPE_STORAGE
	bool "Option to clear the flash area before mounting"
	default n
	help
	  Use this to force an existing file system to be created.

config APP_LITTLEFS_STORAGE_FLASH
	bool "Use flash memory backend"
	default n


module = DATA_MODULE
module-str = data module
source "subsys/logging/Kconfig.template.log_config"

endif # DATA_MODULE
```

## src/data_sd/Kconfig
```kconfig
config DATA_SD_MODULE
	bool "Data Storage System"
	select SPI
	select FLASH
	select FILE_SYSTEM
	select FS_FATFS
	select FS_FATFS_LFN
	select FS_FATFS_EXFAT
	select FS_LITTLEFS_BLK_DEV
	select DISK_ACCESS
	select DISK_DRIVERS
	select DISK_DRIVER_SDMMC


	help
	  DATA_MODULE_SD

if DATA_SD_MODULE

config DATA_SD_MODULE_LOG_LEVEL
	int "Data module SD log level"
	depends on DATA_SD_MODULE && LOG
	default 4
	help
	  Sets log level for Data SD module

# Config the file system
config FILE_SYSTEM
	default y

config FAT_FILESYSTEM_ELM
	default y


# Allocate buffer on RAM for transferring chunck of data
# from Flash to SPI
config SPI_NRFX_RAM_BUFFER_SIZE
	default 8


config FILE_SYSTEM_MOUNT
	string
	default "/sd"

config FPU
	default y

config FPU_SHARING
	default y

config FS_LITTLEFS_BLK_DEV
	default y

config FS_LITTLEFS_FMP_DEV
	default n	

config CONFIG_FS_FATFS_MAX_LFN
	int
	default 255

# Enable SPI interface
config SPI
	default y

config LAB_VERSION
	bool "Lab version"
	default n

config DATA_SD_MODULE_STACK_SIZE
	int "Data module thread stack size"
	default 4096

config DATA_SD_MODULE_PRIORITY
	int "Data module thread priority"
	default 7

config BT_LONG_WQ_STACK_SIZE
	int
	default 4096	

config DATA_SD_LOG_SPACE_LEFT_THRESHOLD_KB
	int  "Flash memory minimum free space in Kbytes to trigger file deletion"
	default 200

config DATA_SD_DELETE_DAYS
	int "Number of logg days to delete if not enough space on the external flash"	
	default 7

config APP_WIPE_STORAGE
	bool "Option to clear the flash area before mounting"
	default n
	help
	  Use this to force an existing file system to be created.

module = DATA_SD_MODULE
module-str = data sd module
source "subsys/logging/Kconfig.template.log_config"

endif # DATA_SD_MODULE
```

## src/foot_sensor/Kconfig
```kconfig
config FOOT_SENSOR_MODULE
	bool "Foot Sensor Module"
	select ADC
	help
	  FOOT_SENSOR MODULE using Zephyr ADC driver

if FOOT_SENSOR_MODULE

module = FOOT_SENSOR_MODULE
module-str = FOOT_SENSOR module
source "subsys/logging/Kconfig.template.log_config"

config FOOT_SENSOR_OPTIONAL
	bool "Make foot sensor optional (non-critical for boot)"
	default n
	help
	  If enabled, the system will continue to boot even if foot sensor
	  initialization fails. If disabled, foot sensor failure will prevent
	  system startup.

config FOOT_SENSOR_USE_SIMPLE
	bool "Use simplified thread-based ADC implementation"
	default y
	help
	  Use simplified implementation with Zephyr ADC driver and thread-based
	  sampling instead of complex NRFX/DPPI/Timer implementation

endif # FOOT_SENSOR_MODULE
```
