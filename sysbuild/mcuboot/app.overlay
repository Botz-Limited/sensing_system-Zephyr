/* MCUboot overlay to fix QSPI alignment issues */

&qspi {
	mx25r64: mx25r6435f@0 {
		/* Ensure 4-byte aligned reads */
		sfdp-bfp = [
			e5 20 f1 ff  ff ff ff 03  44 eb 08 6b  08 3b 04 bb
			ee ff ff ff  ff ff 00 ff  ff ff 00 ff  0c 20 0f 52
			10 d8 00 ff  23 72 f5 00  82 ed 04 cc  44 83 68 44
			30 b0 30 b0  f7 c4 d5 5c  00 be 29 ff  f0 d0 ff ff
		];
		size = <67108864>;
		jedec-id = [c2 28 17];
		sfdp-bfp;
		status = "okay";
	};
};