/ {
    model = "Nordic NRF5340 Application";
    compatible = "nordic,nrf5340-dk-nrf5340-cpuapp";

    chosen {
        nordic,pm-ext-flash = &w25q128;
    };
};

&qspi {
    status = "okay";
    pinctrl-0 = <&qspi_default>;
    pinctrl-1 = <&qspi_sleep>;
    pinctrl-names = "default", "sleep";
    
    /delete-node/ mx25r6435f@0;
    
    w25q128: w25q128jv@0 {
        compatible = "nordic,qspi-nor";
        reg = <0>;
        sck-frequency = <8000000>;
        jedec-id = [ef 40 18];

        size = <134217728>; // 128 Mbit = 16 MB
        has-dpd;
        t-enter-dpd = <10000>;
        t-exit-dpd = <35000>;
        status = "okay";
    };
};