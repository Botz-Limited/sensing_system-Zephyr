## tests/bluetooth/testcase.yaml
```yaml
tests:
  bluetooth.unit:
    platform_allow: native_posix
    tags: bluetooth unit
```

## tests/control_service/testcase.yaml
```yaml
tests:
  control_service.test:
    platform_allow: native_posix
    tags: control_service
```

## tests/data/build/Kconfig/arch/Kconfig
```kconfig
# Load Zephyr Arch Kconfig descriptions.
osource "/home/ee/ncs/zephyr/arch/x86/Kconfig"
osource "/home/ee/ncs/zephyr/arch/xtensa/Kconfig"
osource "/home/ee/ncs/zephyr/arch/sparc/Kconfig"
osource "/home/ee/ncs/zephyr/arch/riscv/Kconfig"
osource "/home/ee/ncs/zephyr/arch/posix/Kconfig"
osource "/home/ee/ncs/zephyr/arch/nios2/Kconfig"
osource "/home/ee/ncs/zephyr/arch/mips/Kconfig"
osource "/home/ee/ncs/zephyr/arch/arm64/Kconfig"
osource "/home/ee/ncs/zephyr/arch/arm/Kconfig"
osource "/home/ee/ncs/zephyr/arch/arc/Kconfig"
```

## tests/data/build/Kconfig/boards/Kconfig.defconfig
```kconfig
# Load Zephyr board defconfig descriptions.
osource "/home/ee/ncs/zephyr/boards/native/native_sim/Kconfig.defconfig"
```

## tests/data/build/Kconfig/boards/Kconfig.native_sim
```kconfig
# Load board Kconfig descriptions.
osource "/home/ee/ncs/zephyr/boards/native/native_sim/Kconfig.native_sim"
```

## tests/data/build/Kconfig/boards/Kconfig.sysbuild
```kconfig
# Load Sysbuild board Kconfig descriptions.
osource "/home/ee/ncs/zephyr/boards/native/native_sim/Kconfig.sysbuild"
```

## tests/data/build/data/Kconfig/boards/Kconfig
```kconfig
# Load Zephyr board Kconfig descriptions.
osource "/home/ee/ncs/zephyr/boards/native/native_sim/Kconfig"
```

## tests/data/testcase.yaml
```yaml
tests:
  data.unit:
    platform_allow: native_posix
    tags: data unit filesystem
```

## tests/foot_sensor/testcase.yaml
```yaml
tests:
  foot_sensor.test:
    platform_allow: native_posix
    tags: foot_sensor
```

## tests/motion_sensor/testcase.yaml
```yaml
tests:
  motion_sensor.test:
    platform_allow: native_posix
    tags: motion_sensor
```

## tests/packetizer/testcase.yaml
```yaml
tests:
  packetizer.unit:
    platform_allow: native_posix
    tags: packetizer unit
```

## tests/realtime_metrics/testcase.yaml
```yaml
tests:
  realtime_metrics.unit:
    platform_allow: native_posix native_posix_64
    tags: realtime_metrics unit
    harness: ztest
    min_ram: 32
    min_flash: 64
```

## tests/sensor_data/testcase.yaml
```yaml
tests:
  sensor_data.unit:
    platform_allow: native_posix native_posix_64
    tags: sensor_data unit
    harness: ztest
    min_ram: 32
    min_flash: 64
```
