## drivers/sensor/bosch/bhi360/Kconfig
```kconfig
# Copyright (c) 2024 CATIE
# SPDX-License-Identifier: Apache-2.0

menuconfig BHI360
    bool "Bosch Sensortec GmbH BHI360"
    default y
    depends on DT_HAS_BOSCH_BHI360_ENABLED
    select SPI
    help
      Enable driver for Bosch Sensortec GmbH BHI360

if BHI360

module = BHI360_MODULE
module-str = app module
source "subsys/logging/Kconfig.template.log_config"

config BHI360_AUTO_CALIBRATION
    bool "Automatic calibration on startup"
    default y
    help
      Enable automatic calibration check and calibration during initialization.
      When enabled, the driver will check calibration status and perform
      Fast Offset Compensation (FOC) for gyroscope and accelerometer if needed.

config BHI360_CALIBRATION_THRESHOLD
    int "Calibration accuracy threshold (0-4)"
    default 3
    range 0 4
    help
      Minimum calibration accuracy required. If current calibration is below
      this threshold, automatic calibration will be performed.
      0 = Not calibrated
      1 = Calibration in progress
      2 = Low accuracy
      3 = Medium accuracy
      4 = High accuracy

endif # BHI360
```

## drivers/sensor/ti/bq25185/Kconfig
```kconfig
# Copyright Botz 2025


menuconfig BQ25185
    bool "BQ25185 Battery Charger Monitor"
    default y
    depends on DT_HAS_TI_BQ25185_ENABLED
    select SPI
    help
      Enable driver for Texas Instruments BQ25185 battery charger monitor.
      This driver supports monitoring battery status via STAT1 and STAT2 GPIO pins.

if BQ25185

module = BQ25185_MODULE
module-str = app module
source "subsys/logging/Kconfig.template.log_config"



endif # BQ25185
```

## drivers/sensor/ti/bq25185/dts/bindings/ti,bq25185.yaml
```yaml
description: Texas Instruments BQ25185 Battery Charger

compatible: "ti,bq25185"

include: [base.yaml]

properties:
  stat1-gpios:
    type: phandle-array
    required: true
    description: STAT1 status indicator pin

  stat2-gpios:
    type: phandle-array
    required: true
    description: STAT2 status indicator pin

  charging-current-ua:
    type: int
    default: 500000
    description: Charging current in microamps (default 500mA)

  charging-voltage-uv:
    type: int
    default: 4200000
    description: Charging voltage in microvolts (default 4.2V)
```
