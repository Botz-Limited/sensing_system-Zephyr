## boards/arm/sensing/Kconfig.board
```kconfig
# Copyright (c) 2023 Nordic Semiconductor ASA
# SPDX-License-Identifier: Apache-2.0

config BOARD_SENSING
	bool "Sensing board"
	select SOC_NRF54L15
	select SOC_SERIES_NRF54LX
    depends on SOC_FAMILY_NRF
```

## boards/arm/sensing/Kconfig.defconfig
```kconfig
# Copyright (c) 2024 Nordic Semiconductor ASA
# SPDX-License-Identifier: Apache-2.0

# Workaround for not being able to have commas in macro arguments
DT_CHOSEN_Z_CODE_PARTITION := zephyr,code-partition
DT_CHOSEN_Z_SRAM_PARTITION := zephyr,sram-secure-partition

if BOARD_NRF54L15DK_NRF54L05_CPUAPP || BOARD_NRF54L15DK_NRF54L10_CPUAPP || \
	BOARD_NRF54L15DK_NRF54L15_CPUAPP

config ROM_START_OFFSET
	default 0x800 if BOOTLOADER_MCUBOOT

endif # BOARD_NRF54L15DK_NRF54L05_CPUAPP || BOARD_NRF54L15DK_NRF54L10_CPUAPP || \
	# BOARD_NRF54L15DK_NRF54L15_CPUAPP


config SOC_NRF54L15_CPUAPP
    bool
    default y



config BT_CTLR
	default BT

config ROM_START_OFFSET
	default 0x800 if BOOTLOADER_MCUBOOT

config FLASH_LOAD_OFFSET
	default $(dt_chosen_reg_addr_hex,$(DT_CHOSEN_Z_CODE_PARTITION))

config FLASH_LOAD_SIZE
	default $(dt_chosen_reg_size_hex,$(DT_CHOSEN_Z_CODE_PARTITION))    
```

## boards/arm/sensing/Kconfig.sensing
```kconfig
config BOARD_SENSING
	select SOC_NRF54L15_CPUAPP if BOARD_SENSING_NRF54L15_CPUAPP
	select SOC_NRF54L15_CPUFLPR if \
		BOARD_SENSING_NRF54L15_CPUFLPR || \
		BOARD_SENSING_NRF54L15_CPUFLPR_XIP
```

## boards/arm/sensing/board.yml
```yaml
board:
  name: sensing
  full_name: nRF54L15 DK
  vendor: nordic
  socs:
  - name: nrf54l15
    variants:
    - name: ns
      cpucluster: cpuapp
```

## boards/nrf5340dk_nrf5340_cpuapp.conf
```kconfig
# Board-specific configuration for nRF5340 DK
# This file is automatically included when building for nrf5340dk_nrf5340_cpuapp

# Increase GATT client subscription capacity for D2D
# The D2D RX client needs to subscribe to 15 characteristics from the secondary device
CONFIG_BT_GATT_CLIENT=y
CONFIG_BT_MAX_CONN=6
CONFIG_BT_MAX_PAIRED=6

# === NOTE: Buffer settings are now in prj.conf and prj_secondary.conf ===
# These are kept here for compatibility but will be overridden by project configs
# Primary uses moderate buffers, Secondary uses higher buffers for D2D TX

# Increase ATT buffers to handle multiple subscriptions
CONFIG_BT_ATT_PREPARE_COUNT=16

# Enable flow control to prevent buffer exhaustion
CONFIG_BT_ATT_ENFORCE_FLOW=y

#CONFIG_BT_RPC_STACK=y
```

## boards/nrf5340dk_nrf5340_cpuapp_defconfig
```kconfig
# SPDX-License-Identifier: Apache-2.0
# Enable MPU
CONFIG_ARM_MPU=y

# Enable hardware stack protection
CONFIG_HW_STACK_PROTECTION=y

# Enable TrustZone-M
CONFIG_ARM_TRUSTZONE_M=y

# enable GPIO
CONFIG_GPIO=y

# Enable uart driver
CONFIG_SERIAL=n

# NanoPB
CONFIG_NANOPB=y

# enable console
CONFIG_CONSOLE=n
CONFIG_UART_CONSOLE=n


# Need this when storage is on MX25R64
CONFIG_NORDIC_QSPI_NOR=y
CONFIG_NORDIC_QSPI_NOR_FLASH_LAYOUT_PAGE_SIZE=4096
CONFIG_NORDIC_QSPI_NOR_STACK_WRITE_BUFFER_SIZE=32

CONFIG_NCS_SAMPLE_MCUMGR_BT_OTA_DFU=y

# Mcumgr callbacks hooks
CONFIG_MCUMGR_MGMT_NOTIFICATION_HOOKS=y
CONFIG_MCUMGR_SMP_COMMAND_STATUS_HOOKS=y
CONFIG_MCUMGR_GRP_IMG_STATUS_HOOKS=y
CONFIG_MCUMGR_GRP_FS_FILE_ACCESS_HOOK=y
```

## boards/nrf5340dk_nrf5340_cpuapp_primary.conf
```kconfig
# Primary device specific configuration
# Disable MCUmgr BT transport to prevent conflicts with dual SMP services
CONFIG_MCUMGR_TRANSPORT_BT=n

# We still need MCUmgr core functionality for the proxy
CONFIG_MCUMGR=y
CONFIG_MCUMGR_GRP_OS=y
CONFIG_MCUMGR_GRP_IMG=y
CONFIG_MCUMGR_GRP_FS=y
CONFIG_MCUMGR_GRP_ZBASIC=y
CONFIG_MCUMGR_GRP_ZBASIC_STORAGE_ERASE=y

# Keep the SMP client configurations for FOTA proxy
CONFIG_SMP_CLIENT=y
CONFIG_DFU_TARGET=y
CONFIG_DFU_TARGET_SMP=y
CONFIG_MCUMGR_GRP_IMG_CLIENT=y
CONFIG_MCUMGR_GRP_OS_CLIENT=y
CONFIG_MCUMGR_GRP_OS_CLIENT_RESET=y

# MCUmgr dependencies
CONFIG_NET_BUF=y
CONFIG_ZCBOR=y
CONFIG_CRC=y
CONFIG_IMG_MANAGER=y
CONFIG_MCUBOOT_IMG_MANAGER=y
CONFIG_STREAM_FLASH=y
CONFIG_FLASH_MAP=y
```

## boards/nrf5340dk_nrf5340_cpuapp_secondary.conf
```kconfig
# Secondary device specific configuration
# This file is used when CONFIG_PRIMARY_DEVICE=n

# Disable the NCS sample MCUmgr for secondary device
# We'll use our custom SMP BT transport implementation
CONFIG_NCS_SAMPLE_MCUMGR_BT_OTA_DFU=n

# Enable MCUmgr core functionality
CONFIG_MCUMGR=y
CONFIG_MCUMGR_GRP_IMG=y
CONFIG_MCUMGR_GRP_OS=y
CONFIG_MCUMGR_GRP_FS=y
CONFIG_MCUMGR_GRP_ZBASIC=y
CONFIG_MCUMGR_GRP_ZBASIC_STORAGE_ERASE=n

# Enable MCUmgr transport infrastructure (but not the default BT transport)
CONFIG_MCUMGR_TRANSPORT_NETBUF_COUNT=4
CONFIG_MCUMGR_TRANSPORT_NETBUF_SIZE=2475
CONFIG_MCUMGR_GRP_OS_MCUMGR_PARAMS=y

# Enable SMP protocol
CONFIG_MCUMGR_SMP_SUPPORT_ORIGINAL_PROTOCOL=y

# Work queue settings
CONFIG_SYSTEM_WORKQUEUE_STACK_SIZE=4096

# Ensure we have the dependencies
CONFIG_NET_BUF=y
CONFIG_ZCBOR=y
CONFIG_CRC=y
```

## boards/nrf5340dk_nrf5340_cpunet_defconfig
```kconfig
# SPDX-License-Identifier: Apache-2.0

# Enable MPU
CONFIG_ARM_MPU=y

# Enable hardware stack protection
CONFIG_HW_STACK_PROTECTION=y

# enable GPIO
CONFIG_GPIO=y

# Enable uart driver
CONFIG_SERIAL=n

# enable console
CONFIG_CONSOLE=n
CONFIG_UART_CONSOLE=n
```

## boards/nrf54l15dk_nrf54l15_cpuapp_defconfig
```kconfig
# Copyright (c) 2024 Nordic Semiconductor ASA
# SPDX-License-Identifier: Apache-2.0

# Enable UART driver
CONFIG_SERIAL=n

# Enable console
CONFIG_CONSOLE=n
CONFIG_UART_CONSOLE=n

# Enable GPIO
CONFIG_GPIO=y

# Enable MPU
CONFIG_ARM_MPU=y

# Enable hardware stack protection
CONFIG_HW_STACK_PROTECTION=y

# MPU-based null-pointer dereferencing detection cannot
# be applied as the (0x0 - 0x400) is unmapped for this target.
CONFIG_NULL_POINTER_EXCEPTION_DETECTION_NONE=y

# Enable Cache
CONFIG_CACHE_MANAGEMENT=y
CONFIG_EXTERNAL_CACHE=y
CONFIG_PM_OVERRIDE_EXTERNAL_DRIVER_CHECK=y

# Start SYSCOUNTER on driver init
CONFIG_NRF_GRTC_START_SYSCOUNTER=y


# Enable RTT
CONFIG_USE_SEGGER_RTT=y

# enable GPIO
CONFIG_GPIO=y

# enable uart driver
CONFIG_SERIAL=y

# additional board options
CONFIG_PINCTRL=y

CONFIG_FILE_SYSTEM_LITTLEFS=y
CONFIG_SPI=y
CONFIG_SPI_NOR=y
CONFIG_PM_EXTERNAL_FLASH_MCUBOOT_SECONDARY=y
CONFIG_SPI_NOR_FLASH_LAYOUT_PAGE_SIZE=4096


CONFIG_PM_PARTITION_SIZE_LITTLEFS=0x677A00
CONFIG_PM_PARTITION_REGION_LITTLEFS_EXTERNAL=y
```

## build/Kconfig/boards/Kconfig.sysbuild
```kconfig
# Load Sysbuild board Kconfig descriptions.
osource "/home/ee/sensing_fw/boards/arm/sensing/Kconfig.sysbuild"
```

## build/mcuboot/Kconfig/boards/Kconfig
```kconfig
# Load Zephyr board Kconfig descriptions.
osource "/home/ee/ncs/zephyr/boards/nordic/nrf5340dk/Kconfig"
```

## build/sensing_fw/Kconfig/Kconfig.modules
```kconfig
menu "nrf (/home/ee/ncs/nrf)"
osource "/home/ee/ncs/nrf/Kconfig.nrf"
config ZEPHYR_NRF_MODULE
	bool
	default y
endmenu
menu "hostap (/home/ee/ncs/modules/lib/hostap)"
osource "$(ZEPHYR_HOSTAP_KCONFIG)"
config ZEPHYR_HOSTAP_MODULE
	bool
	default y
endmenu
menu "mcuboot (/home/ee/ncs/bootloader/mcuboot)"
osource "$(ZEPHYR_MCUBOOT_KCONFIG)"
config ZEPHYR_MCUBOOT_MODULE
	bool
	default y
endmenu
menu "mbedtls (/home/ee/ncs/modules/crypto/mbedtls)"
osource "$(ZEPHYR_MBEDTLS_KCONFIG)"
config ZEPHYR_MBEDTLS_MODULE
	bool
	default y
endmenu
menu "oberon-psa-crypto (/home/ee/ncs/modules/crypto/oberon-psa-crypto)"
osource "/home/ee/ncs/modules/crypto/oberon-psa-crypto/Kconfig.oberon_psa_crypto"
config ZEPHYR_OBERON_PSA_CRYPTO_MODULE
	bool
	default y
endmenu
menu "trusted-firmware-m (/home/ee/ncs/modules/tee/tf-m/trusted-firmware-m)"
osource "$(ZEPHYR_TRUSTED_FIRMWARE_M_KCONFIG)"
config ZEPHYR_TRUSTED_FIRMWARE_M_MODULE
	bool
	default y
endmenu
config ZEPHYR_PSA_ARCH_TESTS_MODULE
	bool
	default y
menu "cjson (/home/ee/ncs/modules/lib/cjson)"
osource "$(ZEPHYR_CJSON_KCONFIG)"
config ZEPHYR_CJSON_MODULE
	bool
	default y
endmenu
menu "azure-sdk-for-c (/home/ee/ncs/modules/lib/azure-sdk-for-c)"
osource "$(ZEPHYR_AZURE_SDK_FOR_C_KCONFIG)"
config ZEPHYR_AZURE_SDK_FOR_C_MODULE
	bool
	default y
endmenu
menu "cirrus-logic (/home/ee/ncs/modules/hal/cirrus-logic)"
osource "/home/ee/ncs/modules/hal/cirrus-logic/Kconfig"
config ZEPHYR_CIRRUS_LOGIC_MODULE
	bool
	default y
endmenu
menu "openthread (/home/ee/ncs/modules/lib/openthread)"
osource "$(ZEPHYR_OPENTHREAD_KCONFIG)"
config ZEPHYR_OPENTHREAD_MODULE
	bool
	default y
endmenu
menu "suit-generator (/home/ee/ncs/modules/lib/suit-generator)"
osource "/home/ee/ncs/modules/lib/suit-generator/ncs/Kconfig"
config ZEPHYR_SUIT_GENERATOR_MODULE
	bool
	default y
endmenu
menu "suit-processor (/home/ee/ncs/modules/lib/suit-processor)"
osource "/home/ee/ncs/modules/lib/suit-processor/Kconfig"
config ZEPHYR_SUIT_PROCESSOR_MODULE
	bool
	default y
endmenu
menu "memfault-firmware-sdk (/home/ee/ncs/modules/lib/memfault-firmware-sdk)"
osource "/home/ee/ncs/modules/lib/memfault-firmware-sdk/ports/zephyr/Kconfig"
config ZEPHYR_MEMFAULT_FIRMWARE_SDK_MODULE
	bool
	default y
endmenu
menu "coremark (/home/ee/ncs/modules/benchmark/coremark)"
osource "$(ZEPHYR_COREMARK_KCONFIG)"
config ZEPHYR_COREMARK_MODULE
	bool
	default y
endmenu
menu "canopennode (/home/ee/ncs/modules/lib/canopennode)"
osource "$(ZEPHYR_CANOPENNODE_KCONFIG)"
config ZEPHYR_CANOPENNODE_MODULE
	bool
	default y
endmenu
menu "chre (/home/ee/ncs/modules/lib/chre)"
osource "/home/ee/ncs/modules/lib/chre/platform/zephyr/Kconfig"
config ZEPHYR_CHRE_MODULE
	bool
	default y
endmenu
menu "lz4 (/home/ee/ncs/modules/lib/lz4)"
osource "$(ZEPHYR_LZ4_KCONFIG)"
config ZEPHYR_LZ4_MODULE
	bool
	default y
endmenu
menu "nanopb (/home/ee/ncs/modules/lib/nanopb)"
osource "$(ZEPHYR_NANOPB_KCONFIG)"
config ZEPHYR_NANOPB_MODULE
	bool
	default y
endmenu
config ZEPHYR_TF_M_TESTS_MODULE
	bool
	default y
menu "zscilib (/home/ee/ncs/modules/lib/zscilib)"
osource "/home/ee/ncs/modules/lib/zscilib/Kconfig.zscilib"
config ZEPHYR_ZSCILIB_MODULE
	bool
	default y
endmenu
menu "cmsis (/home/ee/ncs/modules/hal/cmsis)"
osource "$(ZEPHYR_CMSIS_KCONFIG)"
config ZEPHYR_CMSIS_MODULE
	bool
	default y
endmenu
menu "cmsis-dsp (/home/ee/ncs/modules/lib/cmsis-dsp)"
osource "$(ZEPHYR_CMSIS_DSP_KCONFIG)"
config ZEPHYR_CMSIS_DSP_MODULE
	bool
	default y
endmenu
menu "cmsis-nn (/home/ee/ncs/modules/lib/cmsis-nn)"
osource "$(ZEPHYR_CMSIS_NN_KCONFIG)"
config ZEPHYR_CMSIS_NN_MODULE
	bool
	default y
endmenu
menu "fatfs (/home/ee/ncs/modules/fs/fatfs)"
osource "$(ZEPHYR_FATFS_KCONFIG)"
config ZEPHYR_FATFS_MODULE
	bool
	default y
endmenu
menu "hal_nordic (/home/ee/ncs/modules/hal/nordic)"
osource "$(ZEPHYR_HAL_NORDIC_KCONFIG)"
config ZEPHYR_HAL_NORDIC_MODULE
	bool
	default y

config ZEPHYR_HAL_NORDIC_MODULE_BLOBS
	bool
endmenu
menu "hal_st (/home/ee/ncs/modules/hal/st)"
osource "$(ZEPHYR_HAL_ST_KCONFIG)"
config ZEPHYR_HAL_ST_MODULE
	bool
	default y
endmenu
menu "hal_tdk (/home/ee/ncs/modules/hal/tdk)"
osource "$(ZEPHYR_HAL_TDK_KCONFIG)"
config ZEPHYR_HAL_TDK_MODULE
	bool
	default y
endmenu
config ZEPHYR_HAL_WURTHELEKTRONIK_MODULE
	bool
	default y
menu "liblc3 (/home/ee/ncs/modules/lib/liblc3)"
osource "$(ZEPHYR_LIBLC3_KCONFIG)"
config ZEPHYR_LIBLC3_MODULE
	bool
	default y
endmenu
config ZEPHYR_LIBMETAL_MODULE
	bool
	default y
menu "littlefs (/home/ee/ncs/modules/fs/littlefs)"
osource "$(ZEPHYR_LITTLEFS_KCONFIG)"
config ZEPHYR_LITTLEFS_MODULE
	bool
	default y
endmenu
menu "loramac-node (/home/ee/ncs/modules/lib/loramac-node)"
osource "$(ZEPHYR_LORAMAC_NODE_KCONFIG)"
config ZEPHYR_LORAMAC_NODE_MODULE
	bool
	default y
endmenu
menu "lvgl (/home/ee/ncs/modules/lib/gui/lvgl)"
osource "/home/ee/ncs/modules/lib/gui/lvgl/zephyr/Kconfig"
config ZEPHYR_LVGL_MODULE
	bool
	default y
endmenu
config ZEPHYR_MIPI_SYS_T_MODULE
	bool
	default y
menu "nrf_wifi (/home/ee/ncs/modules/lib/nrf_wifi)"
osource "$(ZEPHYR_NRF_WIFI_KCONFIG)"
config ZEPHYR_NRF_WIFI_MODULE
	bool
	default y

config ZEPHYR_NRF_WIFI_MODULE_BLOBS
	bool
endmenu
config ZEPHYR_OPEN_AMP_MODULE
	bool
	default y
menu "percepio (/home/ee/ncs/modules/debug/percepio)"
osource "/home/ee/ncs/modules/debug/percepio/zephyr/Kconfig"
config ZEPHYR_PERCEPIO_MODULE
	bool
	default y
endmenu
menu "picolibc (/home/ee/ncs/modules/lib/picolibc)"
osource "/home/ee/ncs/modules/lib/picolibc/zephyr/Kconfig"
config ZEPHYR_PICOLIBC_MODULE
	bool
	default y
endmenu
menu "segger (/home/ee/ncs/modules/debug/segger)"
osource "$(ZEPHYR_SEGGER_KCONFIG)"
config ZEPHYR_SEGGER_MODULE
	bool
	default y
endmenu
config ZEPHYR_TINYCRYPT_MODULE
	bool
	default y
menu "uoscore-uedhoc (/home/ee/ncs/modules/lib/uoscore-uedhoc)"
osource "$(ZEPHYR_UOSCORE_UEDHOC_KCONFIG)"
config ZEPHYR_UOSCORE_UEDHOC_MODULE
	bool
	default y
endmenu
menu "zcbor (/home/ee/ncs/modules/lib/zcbor)"
osource "$(ZEPHYR_ZCBOR_KCONFIG)"
config ZEPHYR_ZCBOR_MODULE
	bool
	default y
endmenu
menu "app (/home/ee/sensing_fw/src/app)"
osource "/home/ee/sensing_fw/src/Kconfig"
config ZEPHYR_APP_MODULE
	bool
	default y
endmenu
menu "app_events (/home/ee/sensing_fw/src/app_events)"
osource "/home/ee/sensing_fw/src/Kconfig"
config ZEPHYR_APP_EVENTS_MODULE
	bool
	default y
endmenu
menu "data (/home/ee/sensing_fw/src/data)"
osource "/home/ee/sensing_fw/src/Kconfig"
config ZEPHYR_DATA_MODULE
	bool
	default y
endmenu
menu "bluetooth (/home/ee/sensing_fw/src/bluetooth)"
osource "/home/ee/sensing_fw/src/Kconfig"
config ZEPHYR_BLUETOOTH_MODULE
	bool
	default y
endmenu
menu "drivers (/home/ee/sensing_fw/drivers)"
osource "/home/ee/sensing_fw/drivers/Kconfig"
config ZEPHYR_DRIVERS_MODULE
	bool
	default y
endmenu
menu "nrfxlib (/home/ee/ncs/nrfxlib)"
osource "/home/ee/ncs/nrfxlib/Kconfig.nrfxlib"
config ZEPHYR_NRFXLIB_MODULE
	bool
	default y
endmenu
config ZEPHYR_NRF_HW_MODELS_MODULE
	bool
	default y
menu "connectedhomeip (/home/ee/ncs/modules/lib/matter)"
osource "/home/ee/ncs/modules/lib/matter/config/nrfconnect/chip-module/Kconfig"
config ZEPHYR_CONNECTEDHOMEIP_MODULE
	bool
	default y
endmenu
```

## build/sensing_fw/Kconfig/boards/Kconfig.defconfig
```kconfig
# Load Zephyr board defconfig descriptions.
osource "/home/ee/sensing_fw/boards/arm/sensing/Kconfig.defconfig"
```

## build_primary/Kconfig/boards/Kconfig.defconfig
```kconfig
# Load Zephyr board defconfig descriptions.
osource "/home/ee/ncs/zephyr/boards/nordic/nrf5340dk/Kconfig.defconfig"
```

## build_primary/Kconfig/boards/Kconfig.sysbuild
```kconfig
# Load Sysbuild board Kconfig descriptions.
osource "/home/ee/ncs/zephyr/boards/nordic/nrf5340dk/Kconfig.sysbuild"
```

## build_primary/sensing_fw/Kconfig/Kconfig.shield.defconfig
```kconfig
osource "/home/ee/sensing_fw/boards/shields/*/Kconfig.defconfig"
osource "/home/ee/ncs/nrf/boards/shields/*/Kconfig.defconfig"
```

## build_secondary/ipc_radio/Kconfig/boards/Kconfig.nrf5340dk
```kconfig
# Load board Kconfig descriptions.
osource "/home/ee/ncs/zephyr/boards/nordic/nrf5340dk/Kconfig.nrf5340dk"
```

## build_secondary/mcuboot/Kconfig/Kconfig.shield
```kconfig
osource "/home/ee/sensing_fw/boards/shields/*/Kconfig.shield"
osource "/home/ee/ncs/nrf/boards/shields/*/Kconfig.shield"
```

## drivers/sensor/Kconfig
```kconfig
# Copyright (c) 2024 CATIE
# SPDX-License-Identifier: Apache-2.0


rsource "bosch/Kconfig"
rsource "ti/bq25185/Kconfig"
```

## drivers/sensor/bosch/Kconfig
```kconfig
# Copyright (c) 2024 CATIE
# SPDX-License-Identifier: Apache-2.0

rsource "bhi360/Kconfig"
```
